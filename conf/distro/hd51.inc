## conf/distro/hd51.inc
```bitbake
##preferred versions
PREFERRED_VERSION_linux-libc-headers = "4.10"
PREFERRED_VERSION_nativesdk-linux-libc-headers = "4.10"

##preferred providers
PREFERRED_PROVIDER_virtual/kernel = "linux-gfutures"
PREFERRED_PROVIDER_virtual/neutrino = "neutrino-mp-ax51"
PREFFERED_PROVIDER_virtual/libstb-hal = "libstb-hal"
PREFFERED_PROVIDER_virtual/dvb-driver = "gfutures-dvb-modules-hd51"
PREFFERED_PROVIDER_virtual/screengrabber = "grab"
PREFERRED_PROVIDER_virtual/libgles2 = "hd-v3ddriver-hd51"
PREFERRED_PROVIDER_virtual/egl = "hd-v3ddriver-hd51"
```

## conf/layer.conf
```bitbake
LAYERSERIES_COMPAT_neutrino-mp = "zeus"

# We have a conf and classes directory, append to BBPATH
BBPATH .= ":${LAYERDIR}"

# We have a recipes directory containing .bb and .bbappend files, add to BBFILES
BBFILES := "${BBFILES} ${LAYERDIR}/recipes*/*/*.bb \ 
            ${LAYERDIR}/recipes*/*/*.bbappend"

BBFILE_COLLECTIONS += "neutrino-mp"
BBFILE_PATTERN_neutrino-mp := "^${LAYERDIR}/"
BBFILE_PRIORITY_neutrino-mp = "10"

# Additional license directories.
LICENSE_PATH += "${LAYERDIR}/files/custom-licenses"
```
